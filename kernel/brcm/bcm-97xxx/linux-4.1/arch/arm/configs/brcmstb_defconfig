## kernel/brcm/bcm-97xxx/linux-4.1/drivers/bcm_helper/Kconfig
```kconfig
#
# BCM Helper Module configuration
#

config BCM_HELPER
	tristate "BCM Helper"
	default y
	help
	  If you select this option, bcm supported helper APIs will be exported
	  for any kernel module to use its functionality.
	  Currently it has very limited functionality.

	  If unsure, say M, if allowed, otherwise M.
```
